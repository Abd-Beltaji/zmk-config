## boards/shields/corne_left/Kconfig.shield
```kconfig
menu "Corne Left Shield"

config SHIELD_CORNE_LEFT
    bool "Corne Left Shield"
    default y

endmenu
```

## boards/shields/corne_xiao/Kconfig.defconfig
```kconfig
if SHIELD_CORNE_XIAO_LEFT
config ZMK_KEYBOARD_NAME
    default "Corne Xiao Left"
endif

if SHIELD_CORNE_XIAO_RIGHT
config ZMK_KEYBOARD_NAME
    default "Corne Xiao Right"
endif

if SHIELD_CORNE_XIAO_DONGLE
config ZMK_KEYBOARD_NAME
    default "Corne Xiao Dongle"
endif
```

## boards/shields/corne_xiao/Kconfig.shield
```kconfig
config SHIELD_CORNE_XIAO_LEFT
    bool "Corne Xiao Left"
    select ZMK_KEYMAP

config SHIELD_CORNE_XIAO_RIGHT
    bool "Corne Xiao Right"
    select ZMK_KEYMAP

config SHIELD_CORNE_XIAO_DONGLE
    bool "Corne Xiao Dongle"
    select ZMK_KEYMAP
```

## boards/shields/dongle_xiao/Kconfig.defconfig
```kconfig
if SHIELD_DONGLE_XIAO
    config ZMK_SPLIT
        default y
    config ZMK_SPLIT_ROLE_CENTRAL
        default y
endif
```
