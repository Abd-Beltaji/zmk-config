/dts-v1/;
/ {
    fragment@0 {
        target = <&i2c0>;
        __overlay__ {
            status = "okay";
            clock-frequency = <I2C_SPEED_FAST>;
        };
    };

};

// Provide the label expected by upstream Corne definitions
pro_micro_i2c: &i2c0 {};


